## deer_classifier/firmware/dataset_eval/main/Kconfig.projbuild
```kconfig
menu "Deer dataset evaluation"

config DEER_EVAL_HOST_WINDOWS
    bool "QEMU host uses Windows binary file flag"
    default y
    help
        QEMU's native Xtensa SYS_open passes flags directly to the host open
        function. Windows requires O_BINARY (0x8000) for arbitrary RGB bytes.
        Turn this off on Linux/macOS hosts.

endmenu
```

## deer_classifier/firmware/dataset_eval/sdkconfig.defaults
```kconfig
CONFIG_IDF_TARGET="esp32s3"
CONFIG_ESPTOOLPY_FLASHSIZE_4MB=y
CONFIG_PARTITION_TABLE_CUSTOM=y
CONFIG_PARTITION_TABLE_CUSTOM_FILENAME="partitions.csv"
CONFIG_SPIRAM=y
CONFIG_SPIRAM_MODE_QUAD=y
CONFIG_SPIRAM_SPEED_80M=y
CONFIG_SPIRAM_USE_MALLOC=y
CONFIG_SPIRAM_MALLOC_ALWAYSINTERNAL=16384
CONFIG_SPIRAM_MALLOC_RESERVE_INTERNAL=65536
# CONFIG_SPIRAM_MEMTEST is not set
CONFIG_ESP_CONSOLE_UART_DEFAULT=y
CONFIG_ESP_CONSOLE_UART_BAUDRATE=115200
CONFIG_ESP_MAIN_TASK_STACK_SIZE=16384
CONFIG_COMPILER_OPTIMIZATION_PERF=y
# CONFIG_ESP_INT_WDT is not set
# CONFIG_ESP_TASK_WDT_EN is not set
# CONFIG_BOOTLOADER_WDT_ENABLE is not set
# CONFIG_MBEDTLS_HARDWARE_SHA is not set
```

## deer_classifier/firmware/smoke_test/main/Kconfig.projbuild
```kconfig
menu "Deer camera smoke test"

config DEER_PINS_CONFIRMED
    bool "I have entered and checked my actual OV5640 DVP wiring"
    default n
    help
        The Feather has no fixed camera connector pin map. Leave this off until
        all GPIO numbers below match the real wiring. The app refuses capture
        with this option off. Use MCU GPIO numbers, not Feather labels A0 etc.

config DEER_PIN_XCLK
    int "Camera XCLK GPIO"
    range -1 48
    default -1
config DEER_PIN_SDA
    int "Camera SCCB SDA / SIOD GPIO"
    range -1 48
    default -1
config DEER_PIN_SCL
    int "Camera SCCB SCL / SIOC GPIO"
    range -1 48
    default -1
config DEER_PIN_D0
    int "Camera D0 GPIO (OV5640 Y2)"
    range -1 48
    default -1
config DEER_PIN_D1
    int "Camera D1 GPIO (OV5640 Y3)"
    range -1 48
    default -1
config DEER_PIN_D2
    int "Camera D2 GPIO (OV5640 Y4)"
    range -1 48
    default -1
config DEER_PIN_D3
    int "Camera D3 GPIO (OV5640 Y5)"
    range -1 48
    default -1
config DEER_PIN_D4
    int "Camera D4 GPIO (OV5640 Y6)"
    range -1 48
    default -1
config DEER_PIN_D5
    int "Camera D5 GPIO (OV5640 Y7)"
    range -1 48
    default -1
config DEER_PIN_D6
    int "Camera D6 GPIO (OV5640 Y8)"
    range -1 48
    default -1
config DEER_PIN_D7
    int "Camera D7 GPIO (OV5640 Y9)"
    range -1 48
    default -1
config DEER_PIN_VSYNC
    int "Camera VSYNC GPIO"
    range -1 48
    default -1
config DEER_PIN_HREF
    int "Camera HREF GPIO"
    range -1 48
    default -1
config DEER_PIN_PCLK
    int "Camera PCLK GPIO"
    range -1 48
    default -1
config DEER_PIN_PWDN
    int "Camera PWDN GPIO (-1 if tied inactive on breakout)"
    range -1 48
    default -1
config DEER_PIN_RESET
    int "Camera RESET GPIO (-1 if tied inactive on breakout)"
    range -1 48
    default -1

config DEER_THRESHOLD_PERCENT
    int "Deer gate confidence threshold (percent)"
    range 10 100
    default 85
    help
        Diagnostic starting value, not a validated product threshold. The
        serial log also reports lower scores to help diagnose misses.

config DEER_FRAME_INTERVAL_MS
    int "Pause after each inference (milliseconds)"
    range 0 10000
    default 250

config DEER_CAMERA_VGA
    bool "Use VGA JPEG instead of QVGA (requires more free memory)"
    default n

config DEER_CAMERA_XCLK_MHZ
    int "External camera XCLK frequency (MHz)"
    range 6 27
    default 20
    help
        20 MHz follows Espressif's camera-driver default. Adafruit documents
        a nominal 24 MHz external clock. Keep the breakout clock jumper at
        EXT when the MCU drives XCLK. Confirm capture on the real unit.

config DEER_CAMERA_HMIRROR
    bool "Mirror the camera image horizontally"
    default n

config DEER_CAMERA_VFLIP
    bool "Flip the camera image vertically"
    default n

config DEER_RUN_MODEL_SELFTEST
    bool "Run ESP-DL embedded input/output test vectors at boot"
    default n
    help
        Enable only when the exported model contains test inputs and outputs.
        A failed test stops startup. Passing verifies tensor execution, not
        deer recognition or the camera image path.

endmenu
```

## deer_classifier/firmware/smoke_test/sdkconfig.defaults
```kconfig
CONFIG_IDF_TARGET="esp32s3"
CONFIG_ESPTOOLPY_FLASHSIZE_4MB=y
CONFIG_PARTITION_TABLE_CUSTOM=y
CONFIG_PARTITION_TABLE_CUSTOM_FILENAME="partitions.csv"
CONFIG_SPIRAM=y
CONFIG_SPIRAM_MODE_QUAD=y
CONFIG_SPIRAM_SPEED_80M=y
CONFIG_SPIRAM_USE_MALLOC=y
CONFIG_SPIRAM_MALLOC_ALWAYSINTERNAL=16384
CONFIG_SPIRAM_MALLOC_RESERVE_INTERNAL=65536
CONFIG_ESP_CONSOLE_USB_SERIAL_JTAG=y
CONFIG_ESP_MAIN_TASK_STACK_SIZE=12288
CONFIG_COMPILER_OPTIMIZATION_PERF=y
CONFIG_OV5640_SUPPORT=y
```
